// Copyright (c) 2023 Pascal Riesinger
// SPDX-License-Identifier: MIT
//
// KarlKB keymap.
//
// Homerow mods follow urob's "timeless" configuration:
//   https://github.com/urob/zmk-config#timeless-homerow-mods
//
// The idea: use a large tapping-term (so timing is not the primary decision
// mechanism), combined with `balanced` flavor, `require-prior-idle-ms` (fast
// resolution to "tap" during normal typing), positional hold-tap restricted to
// the opposite hand + thumbs, and `hold-trigger-on-release` (so same-hand
// modifier combos still work when held).

#include <behaviors.dtsi>
#include <dt-bindings/zmk/keys.h>
#include <dt-bindings/zmk/bt.h>
#include <dt-bindings/zmk/outputs.h>

#define HOST_OS 2 // macOS unicode input mode
#include "zmk-helpers/helper.h"
#include "zmk-helpers/unicode-chars/german.dtsi"

// KarlKB-specific key-position labels. Lives next to this keymap because
// ZMK v0.3 does not add ${ZMK_CONFIG} to the DTS preprocessor include path,
// and #include "..." searches the source file's own directory first.
#include "karlkb-key-labels.h"

// Layer aliases
#define DEF 0
#define LEF 1
#define RIG 2
#define TRI 3

// Left-hand homerow-mod row (pinky→index): LSHFT, LCTRL, LALT, LGUI
#define HRML(k1,k2,k3,k4) &hml LSHFT k1  &hml LCTRL k2  &hml LALT k3  &hml LGUI k4
// Right-hand homerow-mod row (index→pinky): RGUI, RALT, RCTRL, RSHFT
#define HRMR(k1,k2,k3,k4) &hmr RGUI k1   &hmr RALT k2   &hmr RCTRL k3 &hmr RSHFT k4

#define HYPER(k) &kp LS(LC(LA(LG(k))))

// Shorter names for some keys
#define BACK C_AC_BACK
#define FWD  C_AC_FORWARD

// Screen grabs (macOS)
#define SG_CLIP LS(LC(LG(N4)))
#define SG_TOOL LS(LG(N3))

#define ___ &trans

// Timeless homerow mods — left hand.
ZMK_HOLD_TAP(hml,
    flavor = "balanced";
    tapping-term-ms = <280>;
    quick-tap-ms = <175>;
    require-prior-idle-ms = <150>;
    hold-trigger-key-positions = <KEYS_R THUMBS>;
    hold-trigger-on-release;
    bindings = <&kp>, <&kp>;
)

// Timeless homerow mods — right hand.
ZMK_HOLD_TAP(hmr,
    flavor = "balanced";
    tapping-term-ms = <280>;
    quick-tap-ms = <175>;
    require-prior-idle-ms = <150>;
    hold-trigger-key-positions = <KEYS_L THUMBS>;
    hold-trigger-on-release;
    bindings = <&kp>, <&kp>;
)

// Thumb layer-tap (used on the two "outer" thumbs). Balanced flavor with a
// shorter tapping-term than the HRMs because thumbs don't suffer from same-hand
// roll false-positives.
ZMK_HOLD_TAP(lt_bal,
    flavor = "balanced";
    tapping-term-ms = <175>;
    quick-tap-ms = <100>;
    bindings = <&mo>, <&kp>;
)

ZMK_CONDITIONAL_LAYER(tri, LEF RIG, TRI)

/ {
    keymap {
        compatible = "zmk,keymap";

        default_layer {
            bindings = <
                // ╭─────────────┬─────────────┬─────────────┬─────────────┬─────────────┬─────────────╮                               ╭─────────────┬─────────────┬─────────────┬─────────────┬─────────────┬─────────────╮
                      &kp TAB       &kp Q         &kp W         &kp E         &kp R         &kp T                                         &kp Y         &kp U         &kp I         &kp O         &kp P         &kp BSPC
                // ├─────────────┼─────────────┼─────────────┼─────────────┼─────────────┼─────────────┤                               ├─────────────┼─────────────┼─────────────┼─────────────┼─────────────┼─────────────┤
                    &mt LCTRL ESC   HRML(A,       S,            D,            F)            &kp G                                         &kp H         HRMR(J,       K,            L,            SEMI)         &kp SQT
                // ├─────────────┼─────────────┼─────────────┼─────────────┼─────────────┼─────────────┤                               ├─────────────┼─────────────┼─────────────┼─────────────┼─────────────┼─────────────┤
                      &kp LSHFT     &kp Z         &kp X         &kp C         &kp V         &kp B                                         &kp N         &kp M         &kp COMMA     &kp DOT       &kp FSLH      &kp RSHFT
                // ╰─────────────┴─────────────┼─────────────┼─────────────┼─────────────┼─────────────┼─────────────╮   ╭─────────────┼─────────────┼─────────────┼─────────────┼─────────────┼─────────────┴─────────────╯
                                                                                       &lt_bal LEF BSPC  &kp RET            &kp TAB   &lt_bal RIG SPACE
                //                                                                       ╰─────────────┴─────────────╯   ╰─────────────┴─────────────╯
            >;
        };

        left_layer {
            bindings = <
                // ╭─────────────┬─────────────┬─────────────┬─────────────┬─────────────┬─────────────╮                               ╭─────────────┬─────────────┬─────────────┬─────────────┬─────────────┬─────────────╮
                      &kp GRAVE     &kp N1        &kp N2        &kp N3        &kp N4        &kp N5                                        &kp N6        &kp N7        &kp N8        &kp N9        &kp N0        &kp BSPC
                // ├─────────────┼─────────────┼─────────────┼─────────────┼─────────────┼─────────────┤                               ├─────────────┼─────────────┼─────────────┼─────────────┼─────────────┼─────────────┤
                         ___        &kp EXCL      &kp AT        &kp HASH      &kp DLLR      &kp PRCNT                                     &kp CARET     &kp AMPS   &kp KP_MULTIPLY  &kp LPAR      &kp RPAR      &kp PIPE
                // ├─────────────┼─────────────┼─────────────┼─────────────┼─────────────┼─────────────┤                               ├─────────────┼─────────────┼─────────────┼─────────────┼─────────────┼─────────────┤
                         ___        &kp EQUAL     &kp MINUS     &kp KP_PLUS   &kp LBRC      &kp RBRC                                      &kp LBKT      &kp RBKT      &kp SEMI      &kp COLON     &kp BSLH         ___
                // ╰─────────────┴─────────────┼─────────────┼─────────────┼─────────────┼─────────────┼─────────────╮   ╭─────────────┼─────────────┼─────────────┼─────────────┼─────────────┼─────────────┴─────────────╯
                                                                                                ___           ___               ___          ___
                //                                                                       ╰─────────────┴─────────────╯   ╰─────────────┴─────────────╯
            >;
        };

        right_layer {
            bindings = <
                // ╭─────────────┬─────────────┬─────────────┬─────────────┬─────────────┬─────────────╮                               ╭─────────────┬─────────────┬─────────────┬─────────────┬─────────────┬─────────────╮
                         ___        &kp F1        &kp F2        &kp F3        &kp F4           ___                                        &kp C_PREV    &kp C_VOL_DN  &kp C_VOL_UP  &kp C_NEXT   &kp C_MUTE     &kp C_PP
                // ├─────────────┼─────────────┼─────────────┼─────────────┼─────────────┼─────────────┤                               ├─────────────┼─────────────┼─────────────┼─────────────┼─────────────┼─────────────┤
                         ___        &kp F5        &kp F6        &kp F7        &kp F8           ___                                        &kp LEFT      &kp DOWN      &kp UP        &kp RIGHT     &kp DEL       &kp BSPC
                // ├─────────────┼─────────────┼─────────────┼─────────────┼─────────────┼─────────────┤                               ├─────────────┼─────────────┼─────────────┼─────────────┼─────────────┼─────────────┤
                         ___        &kp F9        &kp F10       &kp F11       &kp F12          ___                                        &kp HOME      &kp PG_DN     &kp PG_UP     &kp END          ___           ___
                // ╰─────────────┴─────────────┼─────────────┼─────────────┼─────────────┼─────────────┼─────────────╮   ╭─────────────┼─────────────┼─────────────┼─────────────┼─────────────┼─────────────┴─────────────╯
                                                                                                ___           ___               ___          ___
                //                                                                       ╰─────────────┴─────────────╯   ╰─────────────┴─────────────╯
            >;
        };

        tri_layer {
            bindings = <
                // ╭─────────────┬─────────────┬─────────────┬─────────────┬─────────────┬─────────────╮                               ╭─────────────┬─────────────┬─────────────┬─────────────┬─────────────┬─────────────╮
                         ___        HYPER(Q)     HYPER(W)       HYPER(E)      HYPER(R)      HYPER(T)                                     &bt BT_SEL 0  &bt BT_SEL 1  &bt BT_SEL 2  &bt BT_SEL 3      ___        &bt BT_CLR
                // ├─────────────┼─────────────┼─────────────┼─────────────┼─────────────┼─────────────┤                               ├─────────────┼─────────────┼─────────────┼─────────────┼─────────────┼─────────────┤
                         ___        HYPER(A)     HYPER(S)       HYPER(D)      HYPER(F)      HYPER(G)                                      &kp BACK       &kp DOWN      &kp UP        &kp FWD       &kp DEL      &kp BSPC
                // ├─────────────┼─────────────┼─────────────┼─────────────┼─────────────┼─────────────┤                               ├─────────────┼─────────────┼─────────────┼─────────────┼─────────────┼─────────────┤
                         ___        HYPER(Z)     HYPER(X)       HYPER(C)      HYPER(V)      HYPER(B)                                     &kp SG_TOOL   &kp SG_CLIP    &kp PG_UP      &kp END         ___       &out OUT_TOG
                // ╰─────────────┴─────────────┼─────────────┼─────────────┼─────────────┼─────────────┼─────────────╮   ╭─────────────┼─────────────┼─────────────┼─────────────┼─────────────┼─────────────┴─────────────╯
                                                                                                ___           ___               ___          ___
                //                                                                       ╰─────────────┴─────────────╯   ╰─────────────┴─────────────╯
            >;
        };
    };
};
