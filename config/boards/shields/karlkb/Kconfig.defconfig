## config/boards/shields/karlkb/Kconfig.defconfig
```kconfig
if SHIELD_KARLKB_LEFT

config ZMK_KEYBOARD_NAME
    default "KarlKB"

config ZMK_SPLIT_ROLE_CENTRAL
    default y

endif

if SHIELD_KARLKB_LEFT || SHIELD_KARLKB_RIGHT

config ZMK_SPLIT
    default y

endif
```

## config/boards/shields/karlkb/Kconfig.shield
```kconfig
config SHIELD_KARLKB_LEFT
    def_bool $(shields_list_contains,karlkb_left)

config SHIELD_KARLKB_RIGHT
    def_bool $(shields_list_contains,karlkb_right)
```
